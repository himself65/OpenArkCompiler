/* Script for -pie -z combreloc: position independent executable, combine & sort relocs */
/*
 * Copyright (c) [2020] Huawei Technologies Co.,Ltd.All rights reserved.
 *
 * OpenArkCompiler is licensed under the Mulan PSL v1.
 * You can use this software according to the terms and conditions of the Mulan PSL v1.
 * You may obtain a copy of Mulan PSL v1 at:
 *
 *     http://license.coscl.org.cn/MulanPSL
 *
 * THIS SOFTWARE IS PROVIDED ON AN "AS IS" BASIS, WITHOUT WARRANTIES OF ANY KIND, EITHER
 * EXPRESS OR IMPLIED, INCLUDING BUT NOT LIMITED TO NON-INFRINGEMENT, MERCHANTABILITY OR
 * FIT FOR A PARTICULAR PURPOSE.
 * See the Mulan PSL v1 for more details.
 */
OUTPUT_FORMAT("elf64-littleaarch64", "elf64-bigaarch64",
              "elf64-littleaarch64")
OUTPUT_ARCH(aarch64)
SEARCH_DIR("=/usr/local/lib/aarch64-linux-gnu"); SEARCH_DIR("=/lib/aarch64-linux-gnu"); SEARCH_DIR("=/usr/lib/aarch64-linux-gnu"); SEARCH_DIR("=/usr/local/lib"); SEARCH_DIR("=/lib"); SEARCH_DIR("=/usr/lib"); SEARCH_DIR("=/usr/aarch64-linux-gnu/lib");
PHDRS
{
  text PT_LOAD FILEHDR PHDRS;
  data PT_LOAD;
  dynamic PT_DYNAMIC;
  note PT_NOTE;
  gnu_eh_frame PT_GNU_EH_FRAME;
  gnu_stack PT_GNU_STACK;
  gnu_relro PT_GNU_RELRO;
  /*  headers PT_PHDR PHDRS; */ /* Reserve segment for lld */
  /*  interp PT_INTERP;      */ /* Reserve segment for lld */
  thread_local PT_TLS;          /* Reserve segment for lld */
}

SECTIONS
{
  PROVIDE_HIDDEN(__maple_start__ = .);
  /* Read-only sections, merged into text segment: */
  PROVIDE (__executable_start = SEGMENT_START("text-segment", 0)); . = SEGMENT_START("text-segment", 0) + SIZEOF_HEADERS;
  .interp         : { *(.interp) }
  .note.gnu.build-id :
  {
    PROVIDE_HIDDEN (__linkerHashSo_begin = .);
    KEEP (*(.note.gnu.build-id))
    PROVIDE_HIDDEN (__linkerHashSo_end = .);
  } :text :note
  .hash           : { *(.hash) } :text
  .gnu.hash       : { *(.gnu.hash) }
  .dynsym         : { *(.dynsym) }
  .dynstr         : { *(.dynstr) }
  .gnu.version    : { *(.gnu.version) }
  .gnu.version_d  : { *(.gnu.version_d) }
  .gnu.version_r  : { *(.gnu.version_r) }
  .rela.dyn       :
    {
      *(.rela.init)
      *(.rela.text .rela.text.* .rela.gnu.linkonce.t.*)
      *(.rela.fini)
      *(.rela.rodata .rela.rodata.* .rela.gnu.linkonce.r.*)
      *(.rela.data .rela.data.* .rela.gnu.linkonce.d.*)
      *(.rela.tdata .rela.tdata.* .rela.gnu.linkonce.td.*)
      *(.rela.tbss .rela.tbss.* .rela.gnu.linkonce.tb.*)
      *(.rela.ctors)
      *(.rela.dtors)
      *(.rela.got)
      *(.rela.bss .rela.bss.* .rela.gnu.linkonce.b.*)
      *(.rela.ifunc)
    }
  .rela.plt       :
    {
      *(.rela.plt)
      PROVIDE_HIDDEN (__rela_iplt_start = .);
      *(.rela.iplt)
      PROVIDE_HIDDEN (__rela_iplt_end = .);
    }
  .init           :
  {
    KEEP (*(.init))
  } =0
  .plt            : ALIGN(16) { *(.plt) *(.iplt) }
  .text           :
  {
    *(.text.unlikely .text.*_unlikely .text.unlikely.*)
    *(.text.exit .text.exit.*)
    *(.text.startup .text.startup.*)
    *(.text.hot .text.hot.*)
    *(.text .stub .text.* .gnu.linkonce.t.*)
    /* .gnu.warning sections are handled specially by elf32.em.  */
    *(.gnu.warning)
  } =0
  .java_text     :
  {
    PROVIDE_HIDDEN (java_text_begin = .);
    KEEP (*(.java_text))
    PROVIDE_HIDDEN (java_text_end = .);
  }
  .fini           :
  {
    KEEP (*(.fini))
  } =0
  PROVIDE (__etext = .);
  PROVIDE (_etext = .);
  PROVIDE (etext = .);
  .rodata         :
  {
    *(.rodata .rodata.* .gnu.linkonce.r.*)
  }
  .rometadata     :
  {
    mfile_rometadata_method_start = .;
    KEEP (*(.rometadata.method))
    mfile_rometadata_method_end = .;

    mfile_rometadata_field_start = .;
    KEEP (*(.rometadata.field))
    mfile_rometadata_field_end = .;
  }
  .romuidtab      :
  {
    mfile_romuidtab_start = .;
    KEEP (*(.__muid_ro_func_def_orig_tab))
    KEEP (*(.__muid_ro_data_def_orig_tab))
    /* madvised */
    KEEP (*(.__muid_ro_func_inf_tab))
    /* madvised */
    KEEP (*(.__muid_ro_func_def_muid_tab))
    /* madvised */
    KEEP (*(.__muid_ro_data_def_muid_tab))
    KEEP (*(.__muid_ro_func_undef_muid_tab))
    KEEP (*(.__muid_ro_data_undef_muid_tab))
    /* madvised */
    KEEP (*(.__muid_ro_func_muid_idx_tab))
    mfile_romuidtab_end = .;
  }
  .rodata1        : { *(.rodata1) }
  .eh_frame_hdr : { *(.eh_frame_hdr) *(.eh_frame_entry .eh_frame_entry.*) } :text :gnu_eh_frame
  .eh_frame       : ONLY_IF_RO
  {
    PROVIDE_HIDDEN ( __eh_frame_start = .);
    KEEP (*(.eh_frame)) *(.eh_frame.*)
    PROVIDE_HIDDEN ( __eh_frame_end = .);
  } :text
  .gcc_except_table   : ONLY_IF_RO { *(.gcc_except_table
  .gcc_except_table.*) }
  .gnu_extab   : ONLY_IF_RO { *(.gnu_extab*) }
  /* These sections are generated by the Sun/Oracle C++ compiler.  */
  .exception_ranges   : ONLY_IF_RO { *(.exception_ranges
  .exception_ranges*) }

  /* Adjust the address for the data segment.  We want to adjust up to
     the same address within the page on the next page up.  */
  . = DATA_SEGMENT_ALIGN (CONSTANT (MAXPAGESIZE), CONSTANT (COMMONPAGESIZE));
  /* Exception handling  */
  .eh_frame       : ONLY_IF_RW { KEEP (*(.eh_frame)) *(.eh_frame.*) }
  .gnu_extab      : ONLY_IF_RW { *(.gnu_extab) }
  .gcc_except_table   : ONLY_IF_RW { *(.gcc_except_table .gcc_except_table.*) }
  .exception_ranges   : ONLY_IF_RW { *(.exception_ranges .exception_ranges*) }
  /* Thread Local Storage sections  */
  .tdata      : { *(.tdata .tdata.* .gnu.linkonce.td.*) } :thread_local
  .tbss       : { *(.tbss .tbss.* .gnu.linkonce.tb.*) *(.tcommon) } :thread_local
  .dynamic        : { *(.dynamic) } :data :gnu_relro :dynamic
  .preinit_array     :
  {
    PROVIDE_HIDDEN (__preinit_array_start = .);
    KEEP (*(.preinit_array))
    PROVIDE_HIDDEN (__preinit_array_end = .);
  }
  .init_array     :
  {
    PROVIDE_HIDDEN (__init_array_start = .);
    KEEP (*(.init_array.* .ctors.*))
    KEEP (*(.init_array EXCLUDE_FILE (*crtbegin.o *crtbegin?.o *crtend.o *crtend?.o ) .ctors))
    PROVIDE_HIDDEN (__init_array_end = .);
  } :data :gnu_relro
  .fini_array     :
  {
    PROVIDE_HIDDEN (__fini_array_start = .);
    KEEP (*(.fini_array.* .dtors.*))
    KEEP (*(.fini_array EXCLUDE_FILE (*crtbegin.o *crtbegin?.o *crtend.o *crtend?.o ) .dtors))
    PROVIDE_HIDDEN (__fini_array_end = .);
  } :data :gnu_relro
  .ctors          :
  {
    /* gcc uses crtbegin.o to find the start of
       the constructors, so we make sure it is
       first.  Because this is a wildcard, it
       doesn't matter if the user does not
       actually link against crtbegin.o; the
       linker won't look for a file to match a
       wildcard.  The wildcard also means that it
       doesn't matter which directory crtbegin.o
       is in.  */
    KEEP (*crtbegin.o(.ctors))
    KEEP (*crtbegin?.o(.ctors))
    /* We don't want to include the .ctor section from
       the crtend.o file until after the sorted ctors.
       The .ctor section from the crtend file contains the
       end of ctors marker and it must be last */
    KEEP (*(EXCLUDE_FILE (*crtend.o *crtend?.o ) .ctors))
    KEEP (*(SORT(.ctors.*)))
    KEEP (*(.ctors))
  }
  .dtors          :
  {
    KEEP (*crtbegin.o(.dtors))
    KEEP (*crtbegin?.o(.dtors))
    KEEP (*(EXCLUDE_FILE (*crtend.o *crtend?.o ) .dtors))
    KEEP (*(SORT(.dtors.*)))
    KEEP (*(.dtors))
  }
  .jcr            : { KEEP (*(.jcr)) }
  .data.rel.ro : { *(.data.rel.ro.local* .gnu.linkonce.d.rel.ro.local.*) *(.data.rel.ro .data.rel.ro.* .gnu.linkonce.d.rel.ro.*) }
  .got            : { *(.got) *(.igot) } :data :gnu_relro
  . = DATA_SEGMENT_RELRO_END (24, .);
  .got.plt        : { *(.got.plt)  *(.igot.plt) } :data
  .data           :
  {
    PROVIDE_HIDDEN (__data_section_begin = .);
    *(.data .data.* .gnu.linkonce.d.*)
    SORT(CONSTRUCTORS)
    PROVIDE_HIDDEN (__data_section_end = .);
  }
  .data1          : { *(.data1) }
  _edata = .; PROVIDE (edata = .);
  /* maple specific sections */
  . = ALIGN( 8 );
  .maple.gcrootsmap :
  {
    KEEP (*(.maple.gcrootsmap))
  }

  . = ALIGN( 8 );
  .reg_jni_tab :
  {
    PROVIDE_HIDDEN (__reg_jni_tab_begin = .);
    KEEP (*(.reg_jni_tab))
    PROVIDE_HIDDEN (__reg_jni_tab_end = .);
  }

  . = ALIGN( 8 );
  .reg_jni_func_tab :
  {
    PROVIDE_HIDDEN (__reg_jni_func_tab_begin = .);
    KEEP (*(.reg_jni_func_tab))
    PROVIDE_HIDDEN (__reg_jni_func_tab_end = .);
  }

  . = ALIGN( 8 );
  .bb_profile_strtab :
  {
    PROVIDE_HIDDEN (__bb_profile_strtab_begin = .);
    KEEP (*(.__bb_profile_strtab))
    PROVIDE_HIDDEN (__bb_profile_strtab_end = .);
  }

  . = ALIGN( 8 );
  .bb_profile_tab :
  {
    PROVIDE_HIDDEN (__bb_profile_tab_begin = .);
    KEEP (*(.__bb_profile_tab))
    PROVIDE_HIDDEN (__bb_profile_tab_end = .);
  }

  . = ALIGN( 8 );
  .muid_tab :
  {
    PROVIDE_HIDDEN (__muid_tab_start = .);

    PROVIDE_HIDDEN (__decouple_start__ = .);
    KEEP (*(.__decouple))
    PROVIDE_HIDDEN (__decouple_end__ = .);

    PROVIDE_HIDDEN (__muid_range_tab_begin__ = .);
    KEEP (*(.__muid_range_tab))
    PROVIDE_HIDDEN (__muid_range_tab_end__ = .);

    PROVIDE_HIDDEN (__muid_conststr_start__ = .);
    KEEP (*(.__muid_conststr))
    PROVIDE_HIDDEN (__muid_conststr_end__ = .);

    KEEP (*(.__muid_func_def_tab))
    KEEP (*(.__muid_func_undef_tab))
    KEEP (*(.__muid_data_def_tab))
    KEEP (*(.__muid_data_undef_tab))
    KEEP (*(.__muid_itab))
    KEEP (*(.__muid_vtab))
    KEEP (*(.__muid_vtab_offset_tab))
    KEEP (*(.__muid_field_offset_tab))
    KEEP (*(.__muid_superclass))
    KEEP (*(.__muid_offset_value_table))
    KEEP (*(.__muid_local_classinfo_tab))

    PROVIDE_HIDDEN (__muid_tab_end = .);
  }

  . = ALIGN( 8 );
  .mpl_version :
  {
    PROVIDE_HIDDEN (__compilerVersionNumTab_begin__ = .);
    KEEP (*(.__compilerVersionNumTab))
    PROVIDE_HIDDEN (__compilerVersionNumTab_end__ = .);

    KEEP (*(.__sourceMuidTab))

    PROVIDE_HIDDEN (__compiler_mfile_status_begin__ = .);
    KEEP (*(.__compiler_mfile_status))
    PROVIDE_HIDDEN (__compiler_mfile_status_end__ = .);
  }

  . = ALIGN( 8 );
  .profile_tab :
  {
    KEEP (*(.__profile_func_tab))
  }

  . = ALIGN( 8 );
  .classmetadata :
  {
    KEEP (*(.__muid_classmetadata))
  }

  . = ALIGN( 8 );
  .classmetadata_bucket :
  {
    PROVIDE_HIDDEN (__muid_classmetadata_bucket_begin = .);
    *(.__muid_classmetadata_bucket)
    PROVIDE_HIDDEN (__muid_classmetadata_bucket_end = .);
  }

  .refl_strtab :
  {
    . = ALIGN( 8 );
    PROVIDE_HIDDEN(__reflection_strtab_start__ = .);
    KEEP (*(.reflection_strtab))
    PROVIDE_HIDDEN(__reflection_strtab_end__ = .);
  }

  .refl_strtab.hot :
  {
    . = ALIGN( 8 );
    PROVIDE_HIDDEN(__reflection_start_hot_strtab_start__ = .);
    KEEP (*(.reflection_start_hot_strtab))
    PROVIDE_HIDDEN(__reflection_start_hot_strtab_end__ = .);

    . = ALIGN( 8 );
    PROVIDE_HIDDEN(__reflection_both_hot_strtab_start__ = .);
    KEEP (*(.reflection_both_hot_strtab))
    PROVIDE_HIDDEN(__reflection_both_hot_strtab_end__ = .);

    . = ALIGN( 8 );
    PROVIDE_HIDDEN(__reflection_run_hot_strtab_start__ = .);
    KEEP (*(.reflection_run_hot_strtab))
    PROVIDE_HIDDEN(__reflection_run_hot_strtab_end__ = .);
  }

  . = ALIGN( 4096 );
  __bss_start = . ;  __bss_start__ = . ;
  .bss            :
  {
    PROVIDE_HIDDEN(__bss_section_begin = .);
   *(.dynbss)
   *(.bss .bss.* .gnu.linkonce.b.*)
   *(COMMON)
   /* Align here to ensure that the .bss section occupies space up to
      _end.  Align after .bss to ensure correct alignment even if the
      .bss section disappears because there are no input sections.
      FIXME: Why do we need it? When there is no .bss section, we don't
      pad the .data section.  */
   . = ALIGN(. != 0 ? 64 / 8 : 1);
    PROVIDE_HIDDEN(__bss_section_end = .);
  }
  _bss_end__ = . ; __bss_end__ = . ;

  . = ALIGN(64 / 8);
  . = SEGMENT_START("ldata-segment", .);
  . = ALIGN(64 / 8);
  __end__ = .;
  PROVIDE_HIDDEN(__maple_end__ = .);
  _end = .; PROVIDE (end = .);
  . = DATA_SEGMENT_END (.);
  /* Stabs debugging sections.  */
  .stab          0 : { *(.stab) }
  .stabstr       0 : { *(.stabstr) }
  .stab.excl     0 : { *(.stab.excl) }
  .stab.exclstr  0 : { *(.stab.exclstr) }
  .stab.index    0 : { *(.stab.index) }
  .stab.indexstr 0 : { *(.stab.indexstr) }
  .comment       0 : { *(.comment) }
  /* DWARF debug sections.
     Symbols in the DWARF debugging sections are relative to the beginning
     of the section so we begin them at 0.  */
  /* DWARF 1 */
  .debug          0 : { *(.debug) }
  .line           0 : { *(.line) }
  /* GNU DWARF 1 extensions */
  .debug_srcinfo  0 : { *(.debug_srcinfo) }
  .debug_sfnames  0 : { *(.debug_sfnames) }
  /* DWARF 1.1 and DWARF 2 */
  .debug_aranges  0 : { *(.debug_aranges) }
  .maple_java_debug_aranges  0 : { KEEP(*(.maple_java_debug_aranges)) }
  .debug_pubnames 0 : { *(.debug_pubnames) }
  /* DWARF 2 */
  .debug_info     0 : { *(.debug_info .gnu.linkonce.wi.*) }
  .maple_java_debug_info     0 : { KEEP(*(.maple_java_debug_info)) }
  .debug_abbrev   0 : { *(.debug_abbrev) }
  .maple_java_debug_abbrev   0 : { KEEP(*(.maple_java_debug_abbrev)) }
  .debug_line     0 : { *(.debug_line .debug_line.* .debug_line_end ) }
  .maple_java_debug_line     0 : { KEEP(*(.maple_java_debug_line)) }
  .debug_frame    0 : { *(.debug_frame) }
  .debug_str      0 : { *(.debug_str) }
  .debug_loc      0 : { *(.debug_loc) }
  .debug_macinfo  0 : { *(.debug_macinfo) }
  /* SGI/MIPS DWARF 2 extensions */
  .debug_weaknames 0 : { *(.debug_weaknames) }
  .debug_funcnames 0 : { *(.debug_funcnames) }
  .debug_typenames 0 : { *(.debug_typenames) }
  .debug_varnames  0 : { *(.debug_varnames) }
  /* DWARF 3 */
  .debug_pubtypes 0 : { *(.debug_pubtypes) }
  .debug_ranges   0 : { *(.debug_ranges) }
  .maple_java_debug_ranges   0 : { KEEP(*(.maple_java_debug_ranges)) }
  /* DWARF Extension.  */
  .debug_macro    0 : { *(.debug_macro) }
  .ARM.attributes 0 : { KEEP (*(.ARM.attributes)) KEEP (*(.gnu.attributes)) }
  .note.gnu.arm.ident 0 : { KEEP (*(.note.gnu.arm.ident)) }
  /DISCARD/ : { *(.note.GNU-stack) *(.gnu_debuglink) *(.gnu.lto_*) }
}
